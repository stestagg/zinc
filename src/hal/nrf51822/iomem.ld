PROVIDE(isr_power_clock		= isr_hardfault);
PROVIDE(isr_radio			= isr_hardfault);
PROVIDE(isr_uart0			= isr_hardfault);
PROVIDE(isr_spi_twi0		= isr_hardfault);
PROVIDE(isr_spi_twi1		= isr_hardfault);
PROVIDE(isr_gpiote			= isr_hardfault);
PROVIDE(isr_adc				= isr_hardfault);
PROVIDE(isr_timer0			= isr_hardfault);
PROVIDE(isr_timer1			= isr_hardfault);
PROVIDE(isr_timer2			= isr_hardfault);
PROVIDE(isr_rtc0			= isr_hardfault);
PROVIDE(isr_temp			= isr_hardfault);
PROVIDE(isr_rng				= isr_hardfault);
PROVIDE(isr_ecb				= isr_hardfault);
PROVIDE(isr_ccm_aar			= isr_hardfault);
PROVIDE(isr_wdt				= isr_hardfault);
PROVIDE(isr_rtc1			= isr_hardfault);
PROVIDE(isr_qdec			= isr_hardfault);